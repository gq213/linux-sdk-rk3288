## buildroot/configs/rockchip_rk3288_defconfig
```kconfig
#include "rk3288_arm.config"
#include "base.config"
# BR2_PACKAGE_RKSCRIPT is not set
BR2_ROOTFS_DEVICE_CREATION_DYNAMIC_EUDEV=y
BR2_PACKAGE_E2FSPROGS=y
BR2_PACKAGE_E2FSPROGS_FSCK=y
BR2_PACKAGE_E2FSPROGS_RESIZE2FS=y
BR2_PACKAGE_DOSFSTOOLS=y
BR2_PACKAGE_DOSFSTOOLS_MKFS_FAT=y
#include "gpu.config"
#include "weston.config"
#include "video_mpp.config"
BR2_PACKAGE_ALSA_UTILS=y
BR2_PACKAGE_ALSA_UTILS_AMIXER=y
BR2_PACKAGE_ALSA_UTILS_APLAY=y
BR2_PACKAGE_WPA_SUPPLICANT=y
BR2_PACKAGE_WPA_SUPPLICANT_CLI=y
BR2_PACKAGE_NTP=y
BR2_PACKAGE_BLUEZ5_UTILS=y
BR2_PACKAGE_RKWIFIBT=y
BR2_PACKAGE_RKWIFIBT_AP6255=y
BR2_PACKAGE_RKWIFIBT_BTUART="ttyS0"
BR2_TARGET_GENERIC_HOSTNAME="rk3288"
BR2_TARGET_GENERIC_ISSUE="Welcome to RK3288 Buildroot"
```

## u-boot/board/firefly/firefly-rk3288/Kconfig
```kconfig
if TARGET_FIREFLY_RK3288

config SYS_BOARD
	default "firefly-rk3288"

config SYS_VENDOR
	default "firefly"

config SYS_CONFIG_NAME
	default "rk3288-ff"

config BOARD_SPECIFIC_OPTIONS # dummy
	def_bool y

endif
```
